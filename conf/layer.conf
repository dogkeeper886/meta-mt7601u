## conf/layer.conf
```bitbake
# We have a conf and classes directory, add to BBPATH
BBPATH .= ":${LAYERDIR}"

# We have recipes-* directories, add to BBFILES
BBFILES += "${LAYERDIR}/recipes-*/*/*.bb \
            ${LAYERDIR}/recipes-*/*/*.bbappend"

BBFILE_COLLECTIONS += "meta-mt7601u"
BBFILE_PATTERN_meta-mt7601u = "^${LAYERDIR}/"
BBFILE_PRIORITY_meta-mt7601u = "6"

LAYERDEPENDS_meta-mt7601u = "core"
LAYERSERIES_COMPAT_meta-mt7601u = "kirkstone"
```
